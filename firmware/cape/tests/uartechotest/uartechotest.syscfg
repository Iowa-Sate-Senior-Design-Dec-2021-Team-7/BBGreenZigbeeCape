/**
 * @cliArgs --board "/ti/boards/CC1352R1_LAUNCHXL" --product "simplelink_cc13x2_26x2_sdk@5.20.00.52"
 * @versions {"data":"2021060817","timestamp":"2021060817","tool":"1.8.2+1992","templates":null}
 */

/**
 * Import the modules used in this configuration.
 */
const GPIO  = scripting.addModule("/ti/drivers/GPIO");
const GPIO1 = GPIO.addInstance();
const RTOS  = scripting.addModule("/ti/drivers/RTOS");
const UART  = scripting.addModule("/ti/drivers/UART");
const UART1 = UART.addInstance();

/**
 * Write custom configuration values to the imported modules.
 */
GPIO1.mode              = "Output";
GPIO1.$name             = "CONFIG_GPIO_LED_0";
GPIO1.$hardware         = system.deviceData.board.components.LED_RED;
GPIO1.pinInstance.$name = "CONFIG_PIN_4";

const CCFG              = scripting.addModule("/ti/devices/CCFG", {}, false);
CCFG.ccfgTemplate.$name = "ti_devices_CCFGTemplate0";

UART1.$name               = "CONFIG_UART_0";
UART1.txPinInstance.$name = "CONFIG_PIN_1";
UART1.rxPinInstance.$name = "CONFIG_PIN_2";
UART1.uart.txPin.$assign  = "boosterpack.3";
UART1.uart.rxPin.$assign  = "boosterpack.4";

/**
 * Pinmux solution for unlocked pins/peripherals. This ensures that minor changes to the automatic solver in a future
 * version of the tool will not impact the pinmux you originally saw.  These lines can be completely deleted in order to
 * re-solve from scratch.
 */
GPIO1.gpioPin.$suggestSolution = "boosterpack.39";
UART1.uart.$suggestSolution    = "UART0";
